## project/zephyr/nordic/set_timer_interrupt_out/bd/Kconfig/Kconfig.shield
```kconfig
osource "c:/ncs/custom/boards/shields/*/Kconfig.shield"
osource "c:/z_my_zephyr_projects/my_board/boards/shields/*/Kconfig.shield"
osource "d:/personalprojects/zephyr_boards/boards/shields/*/Kconfig.shield"
osource "C:/ncs/v2.7.0/nrf/boards/shields/*/Kconfig.shield"
```

## project/zephyr/nordic/set_timer_interrupt_out/bd/Kconfig/Kconfig.shield.defconfig
```kconfig
osource "c:/ncs/custom/boards/shields/*/Kconfig.defconfig"
osource "c:/z_my_zephyr_projects/my_board/boards/shields/*/Kconfig.defconfig"
osource "d:/personalprojects/zephyr_boards/boards/shields/*/Kconfig.defconfig"
osource "C:/ncs/v2.7.0/nrf/boards/shields/*/Kconfig.defconfig"
```
